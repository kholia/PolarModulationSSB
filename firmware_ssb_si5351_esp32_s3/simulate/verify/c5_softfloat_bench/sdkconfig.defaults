## firmware_ssb_si5351_esp32_s3/simulate/verify/c5_softfloat_bench/sdkconfig.defaults
```kconfig
CONFIG_COMPILER_OPTIMIZATION_PERF=y
CONFIG_ESP_DEFAULT_CPU_FREQ_MHZ_160=y
CONFIG_ESP_TASK_WDT_EN=n
```

## firmware_ssb_si5351_esp32_s3/src/Kconfig.projbuild
```kconfig
menu "Polar SSB configuration"

    choice POLAR_DEFAULT_PROFILE
        prompt "Default I2C/audio profile"
        default POLAR_PROFILE_2MHZ_32K

        config POLAR_PROFILE_1MHZ_16K
            bool "1 MHz I2C / 16 ksample/s (fallback)"

        config POLAR_PROFILE_2MHZ_16K
            bool "2 MHz I2C / 16 ksample/s (recommended)"

        config POLAR_PROFILE_2MHZ_32K
            bool "2 MHz I2C / 32 ksample/s (experimental)"

        config POLAR_PROFILE_3MHZ_32K
            bool "3 MHz I2C / 32 ksample/s (experimental)"
    endchoice

    config POLAR_I2C_SDA_GPIO
        int "Si5351 SDA GPIO"
        range 0 48
        default 1

    config POLAR_I2C_SCL_GPIO
        int "Si5351 SCL GPIO"
        range 0 48
        default 2

    config POLAR_PTT_GPIO
        int "PTT GPIO"
        range 0 48
        default 14

    config POLAR_AM_PWM_GPIO
        int "Drain-modulation PWM GPIO"
        range 0 48
        default 4

    config POLAR_SI5351_XTAL_HZ
        int "Si5351 crystal frequency (Hz)"
        range 10000000 40000000
        default 25000000

    config POLAR_DRAIN_AM
        bool "Drain (envelope) modulation enabled at boot"
        default n
        help
            Drive the drain modulator from the analytic envelope with a 320 kHz,
            7-bit LEDC PWM and hardware linear fades. Requires the external
            reconstruction filter and modulator. Toggle at run time with *a*.
            The phase-step limiter is bypassed while this is on.

    config POLAR_DRAIN_AM_DELAY_STEPS
        int "Amplitude delay relative to phase (3.125 us PWM periods)"
        range -60 80
        default 6
        help
            Positive values hold the envelope back. The default covers the
            average 2 MHz Si5351 transfer only; the drain filter's group delay
            moves the optimum lower. Calibrate on air per band and sideband
            with *dN*.

endmenu
```
