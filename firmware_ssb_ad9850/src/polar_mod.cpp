#include "polar_mod.h"
#include <stdlib.h>
#include <math.h>

#ifdef PICO_BOARD
#include "pico.h"
#else
#define __not_in_flash_func(x) x
#endif

int modulation_mode = MOD_USB;

// Runtime-tunable parameters (set via CAT commands *eNNN*, *jNNN*)
#if SAMPLE_RATE == 32000
float pm_max_phase_step = 1.0f;
#else
float pm_max_phase_step = 2.0f;
#endif
float pm_soft_knee = 0.002f;

#ifndef SAMPLE_RATE
#define SAMPLE_RATE 32000
#endif

// Hi-Fi mode: 257-tap Hilbert filter for 50-15000 Hz bandwidth
// SSB narrowband: 127-tap for 300-3000 Hz (Blackman-Harris windowed)
#if USE_HIFI
#define HILBERT_TAPS 257
#define HILBERT_DELAY 128  // (HILBERT_TAPS-1)/2
#define HILBERT_BUF 512    // Power-of-2 buffer for branchless modular indexing
#define HILBERT_MASK 511
#else
#define HILBERT_TAPS 127
#define HILBERT_DELAY 63
#define HILBERT_BUF 128
#define HILBERT_MASK 127
#endif

// Filter delay lines (file-scope for reset access)
static float delay_bp[8] = { 0 };
static float pre_emph_state = 0;
static float hilbert_history[HILBERT_BUF] = { 0 };
static int hilbert_idx = 0;
static float last_angle = 0;
static float dc_state = 0.0f;
static float hp2_delay[2] = {0}; // HIFI 2nd-order HPF at 200Hz (Butterworth)
// P2: Adaptive I/Q gain correction — compensates Hilbert FIR magnitude rolloff
// at band edges (especially near 300 Hz) where Q gain droops relative to I.
static float iq_i_rms = 0.0f;
static float iq_q_rms = 0.0f;
static float iq_q_corr = 1.0f;

void polar_mod_reset(void) {
  for (int i = 0; i < 8; i++) delay_bp[i] = 0;
  pre_emph_state = 0;
  for (int i = 0; i < HILBERT_BUF; i++) hilbert_history[i] = 0;
  hilbert_idx = 0;
  last_angle = 0;
  dc_state = 0.0f;
  hp2_delay[0] = hp2_delay[1] = 0;
  iq_i_rms = 0.0f;
  iq_q_rms = 0.0f;
  iq_q_corr = 1.0f;
}

// Biquad filter implementation (float) — Transposed Direct Form II
static inline float biquad_f(float x, float b0, float b1, float b2, float a1, float a2, float *delay) {
  float y = b0 * x + delay[0];
  delay[0] = b1 * x - a1 * y + delay[1];
  delay[1] = b2 * x - a2 * y;
  return y;
}

// 300Hz-3000Hz Bandpass (2nd order HP + 2nd order LP cascade)
// Used only in non-HiFi SSB voice mode
float __not_in_flash_func(filter_bandpass_16k)(float x) {
#if SAMPLE_RATE == 32000
  // Highpass 300Hz at 32kHz (2nd order Butterworth)
  float s1 = biquad_f(x, 0.9592f, -1.9183f, 0.9592f, -1.9166f, 0.9201f, &delay_bp[0]);
  // Lowpass 3000Hz at 32kHz (2nd order Butterworth)
  float s2 = biquad_f(s1, 0.0609f, 0.1217f, 0.0609f, -1.1930f, 0.4364f, &delay_bp[2]);
#else
  // Highpass 300Hz at 16kHz (2nd order Butterworth)
  float s1 = biquad_f(x, 0.9186f, -1.8372f, 0.9186f, -1.8347f, 0.8408f, &delay_bp[0]);
  // Lowpass 3000Hz at 16kHz (2nd order Butterworth)
  float s2 = biquad_f(s1, 0.2452f, 0.4905f, 0.2452f, -0.1369f, 0.1177f, &delay_bp[2]);
#endif
  return s2;
}

/*
 * Hi-Fi Hilbert Transform (257 taps)
 * 50-15000 Hz passband, Blackman-Harris windowed
 * Generated by hilbert_coeffs.py - no runtime cos() calls!
 */
#if USE_HIFI
// Dense coefficient array: only the 128 non-zero values (odd indices 1,3,...,255)
// Sequential access improves cache locality vs stride-2 through 257-element array.
static const float h_hifi_nz[128] = {
  -0.000000f, -0.000001f, -0.000001f, -0.000003f, -0.000004f, -0.000007f, -0.000010f, -0.000015f,
  -0.000020f, -0.000028f, -0.000037f, -0.000049f, -0.000063f, -0.000081f, -0.000103f, -0.000129f,
  -0.000161f, -0.000198f, -0.000243f, -0.000295f, -0.000356f, -0.000428f, -0.000510f, -0.000606f,
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   0.000015f,  0.000010f,  0.000007f,  0.000004f,  0.000003f,  0.000001f,  0.000001f,  0.000000f
};

// 257-tap Hi-Fi Hilbert: dense coefficients + power-of-2 buffer (branchless indexing)
static void __not_in_flash_func(hilbert_f_hifi)(float sample_in, float *i_out, float *q_out) {
  hilbert_history[hilbert_idx] = sample_in;
  float q = 0;
  // 128 multiply-accumulates with sequential coefficient access
  for (int i = 0; i < 128; i++) {
    int k = 2 * i + 1;  // original odd index: 1, 3, 5, ..., 255
    int h_idx = (hilbert_idx - k) & HILBERT_MASK;  // branchless wrap
    q += hilbert_history[h_idx] * h_hifi_nz[i];
  }
  int i_idx = (hilbert_idx - 128) & HILBERT_MASK;
  *i_out = hilbert_history[i_idx];
  *q_out = q;
  hilbert_idx = (hilbert_idx + 1) & HILBERT_MASK;
}
#else
// Dense: 62 non-zero coefficients at even indices 2,4,...,124
// Blackman-Harris windowed — 4-term for better sideband suppression
static const float h_nz[62] = {
  -0.00000213f, -0.00000731f, -0.00001789f, -0.00003683f, -0.00006848f, -0.00011884f,
  -0.00019581f, -0.00030948f, -0.00047240f, -0.00069988f, -0.00101029f, -0.00142530f,
  -0.00197026f, -0.00267452f, -0.00357196f, -0.00470167f, -0.00610908f, -0.00784772f,
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   0.00000731f,  0.00000213f
};
#endif

void __not_in_flash_func(hilbert_f)(float sample_in, float *i_out, float *q_out) {
#if USE_HIFI
  hilbert_f_hifi(sample_in, i_out, q_out);
#else
  hilbert_history[hilbert_idx] = sample_in;
  float q = 0;
  // 62 multiply-accumulates with sequential coefficient access + branchless wrap
  for (int i = 0; i < 62; i++) {
    int k = 2 * (i + 1);  // original even index: 2, 4, ..., 124
    int h_idx = (hilbert_idx - k) & HILBERT_MASK;
    q += hilbert_history[h_idx] * h_nz[i];
  }
  int i_idx = (hilbert_idx - 63) & HILBERT_MASK;
  *i_out = hilbert_history[i_idx];
  *q_out = q;
  hilbert_idx = (hilbert_idx + 1) & HILBERT_MASK;
#endif
}

int __not_in_flash_func(modulation_am_pm_f)(float data, float *ampl_out, float *phase_diff_out) {

#if USE_HIFI
  // Hi-Fi mode: 2nd-order Butterworth HPF at 200Hz @ 32kHz
  // Keeps all signal energy within the Hilbert FIR's flat passband region,
  // significantly reducing I/Q magnitude mismatch at the low-frequency edge.
  // (The 257-tap Hilbert transition band starts at ~125Hz = Fs/N)
  float processed_data = biquad_f(data,
    0.9726f, -1.9452f, 0.9726f,   // b0, b1, b2
    -1.9445f, 0.9460f,             // a1, a2
    hp2_delay);
#else
  // SSB voice mode: narrowband processing
  // Pre-emphasis: +6dB/octave above ~1kHz (matches commercial SSB processors)
  // H(z) = 1 + 0.7*(1 - z^-1) = 1.7 - 0.7*z^-1
  // DC gain: 0 dB, Nyquist gain: +7.6 dB
  float emph_data = data + 0.7f * (data - pre_emph_state);
  pre_emph_state = data;

  // Bandpass filtering (300-3000 Hz)
  float bp_data = filter_bandpass_16k(emph_data);

  float processed_data = bp_data;

  // DC blocker (removes any residual DC from filtering)
#if SAMPLE_RATE == 32000
  float dc_out = processed_data - dc_state;
  dc_state = dc_state * 0.9995f + processed_data * 0.0005f;
  processed_data = dc_out;
#else
  float dc_out = processed_data - dc_state;
  dc_state = dc_state * 0.999f + processed_data * 0.001f;
  processed_data = dc_out;
#endif
#endif  // USE_HIFI

  // ── Hilbert transform: extract I/Q components ─────────────────────────
  float x, y;
  hilbert_f(processed_data, &x, &y);

  // ── P2: Adaptive I/Q gain correction ─────────────────────────────────
  // The finite-length Hilbert FIR has magnitude rolloff at band edges
  // (especially near 300 Hz), causing Q to be weaker than I. This creates
  // I/Q imbalance → imperfect opposite-sideband suppression (~30-35 dB).
  // Track RMS power of both paths and normalize Q to match I.
  const float iq_alpha = 0.002f;  // ~500 sample averaging window
  iq_i_rms += iq_alpha * (x * x - iq_i_rms);
  iq_q_rms += iq_alpha * (y * y - iq_q_rms);
  if (iq_i_rms > 1e-8f && iq_q_rms > 1e-8f) {
    float ratio = sqrtf(iq_i_rms / iq_q_rms);
    // Clamp to sane range — correction should be small (< ±15%)
    if (ratio > 0.85f && ratio < 1.15f) {
      iq_q_corr += 0.0005f * (ratio - iq_q_corr);
    }
  }
  y *= iq_q_corr;

  // Direct sqrt avoids hypotf's unnecessary overflow/underflow protection
  // (audio signals are always in ±1.0 range — no risk of float overflow)
  float ampl = sqrtf(x * x + y * y);
  float angle = atan2f(y, x);

  float angle_diff = angle - last_angle;
  if (angle_diff > M_PI) angle_diff -= 2.0f * M_PI;
  if (angle_diff < -M_PI) angle_diff += 2.0f * M_PI;

  // ── Noise gate: suppress atan2 garbage at signal nulls ────────────────
  // When amplitude is below threshold, atan2(y,x) returns meaningless phase.
  // The resulting angle_diff becomes a massive frequency spike = broadband splatter.
  // Gate BOTH amplitude and phase to zero below the noise floor.
  // Active in ALL modes — non-HIFI mode was previously unprotected.
  const float gate_floor = 0.008f;  // ~-42 dB, below typical speech floor
  if (ampl < gate_floor) {
    ampl = 0.0f;       // Mute amplitude
    angle_diff = 0.0f; // Hold phase — no frequency deviation
  }

  // ── Soft phase limiter (tanh) — active in ALL modes ──────────────────
  // Prevents excessive frequency deviation on loud transients.
  // Without limiting, large phase steps → huge freq deviation → spectral splatter.
  // HiFi mode: use a wider limit (pm_max_phase_step) to preserve fidelity
  // while still catching extreme peaks. Non-HiFi: tighter limit for voice.
  const float max_phase_step = pm_max_phase_step;
  angle_diff = max_phase_step * tanhf(angle_diff / max_phase_step);

  // ── Track ACTUAL transmitted phase, not raw atan2 output ──────────────
  // Always track phase difference for proper SSB modulation
  last_angle += angle_diff;
  if (last_angle > M_PI) last_angle -= 2.0f * M_PI;
  if (last_angle < -M_PI) last_angle += 2.0f * M_PI;

  if (modulation_mode == MOD_LSB) angle_diff = -angle_diff;

  *ampl_out = ampl;
  *phase_diff_out = angle_diff;
  return 0;
}

int modulation_am_pm(int16_t data, int *ampl_out, int *phase_diff_out) {
  float f_data = (float)data / 32768.0f;
  float f_ampl, f_phase_diff;
  modulation_am_pm_f(f_data, &f_ampl, &f_phase_diff);
  *ampl_out = (int)(f_ampl * 32768.0f);
  *phase_diff_out = (int)(f_phase_diff * 16777216.0f / (2.0f * M_PI));
  return 0;
}
